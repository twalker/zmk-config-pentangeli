## boards/shields/pentangeli/Kconfig.defconfig
```kconfig
if SHIELD_PENTANGELI_LEFT

# Name must be less than 16 characters long!
config ZMK_KEYBOARD_NAME
    default "pentangeli"

config ZMK_SPLIT_ROLE_CENTRAL
    default y

endif

if SHIELD_PENTANGELI_LEFT || SHIELD_PENTANGELI_RIGHT

config ZMK_SPLIT
    default y

endif
```

## config/boards/shields/pentangeli/Kconfig.shield
```kconfig
# No whitespace after the comma or in your part name!
config SHIELD_PENTANGELI_LEFT
    def_bool $(shields_list_contains,pentangeli_left)

# No whitespace after the comma or in your part name!
config SHIELD_PENTANGELI_RIGHT
    def_bool $(shields_list_contains,pentangeli_right)
```

## config/west.yml
```yaml
manifest:
  remotes:
    - name: zmkfirmware
      url-base: https://github.com/petejohanson
  projects:
    - name: zmk
      remote: zmkfirmware
      import: app/west.yml
      revision: main
  self:
    path: config
```
